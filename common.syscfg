/**
 * @cliArgs --board "/ti/boards/CC3220SF_LAUNCHXL" --product "simplelink_cc32xx_sdk@4_20_00_07"
 * @versions {"tool":"1.9.0+2015","templates":null}
 */

/**
 * Import the modules used in this configuration.
 */
const DriverLib      = scripting.addModule("/ti/devices/DriverLib");
const Display        = scripting.addModule("/ti/display/Display");
const Display1       = Display.addInstance();
const ADC            = scripting.addModule("/ti/drivers/ADC", {}, false);
const ADC1           = ADC.addInstance();
const ADC2           = ADC.addInstance();
const Board          = scripting.addModule("/ti/drivers/Board");
const Crypto         = scripting.addModule("/ti/drivers/Crypto");
const Crypto1        = Crypto.addInstance();
const DMA            = scripting.addModule("/ti/drivers/DMA");
const GPIO           = scripting.addModule("/ti/drivers/GPIO");
const GPIO1          = GPIO.addInstance();
const GPIO2          = GPIO.addInstance();
const GPIO3          = GPIO.addInstance();
const GPIO4          = GPIO.addInstance();
const GPIO5          = GPIO.addInstance();
const GPIO6          = GPIO.addInstance();
const GPIO7          = GPIO.addInstance();
const GPIO8          = GPIO.addInstance();
const GPIO9          = GPIO.addInstance();
const GPIO10         = GPIO.addInstance();
const GPIO11         = GPIO.addInstance();
const GPIO12         = GPIO.addInstance();
const PWM            = scripting.addModule("/ti/drivers/PWM", {}, false);
const PWM1           = PWM.addInstance();
const Power          = scripting.addModule("/ti/drivers/Power");
const RTOS           = scripting.addModule("/ti/drivers/RTOS");
const SPI            = scripting.addModule("/ti/drivers/SPI");
const Timer          = scripting.addModule("/ti/drivers/Timer");
const Timer1         = Timer.addInstance();
const Timer2         = Timer.addInstance();
const Timer3         = Timer.addInstance();
const UART           = scripting.addModule("/ti/drivers/UART", {}, false);
const UART1          = UART.addInstance();
const Watchdog       = scripting.addModule("/ti/drivers/Watchdog");
const Watchdog1      = Watchdog.addInstance();
const LED            = scripting.addModule("/ti/drivers/apps/LED", {}, false);
const LED1           = LED.addInstance();
const SimpleLinkWifi = scripting.addModule("/ti/drivers/net/wifi/SimpleLinkWifi");
const SlNet          = scripting.addModule("/ti/net/SlNet");
const SlNet1         = SlNet.addInstance();

/**
 * Write custom configuration values to the imported modules.
 */
Display1.$name                          = "CONFIG_Display_0";
Display1.$hardware                      = system.deviceData.board.components.XDS110UART;
Display1.uart.$name                     = "CONFIG_UART_0";
Display1.uart.useDMA                    = true;
Display1.uart.uart.$assign              = "UART0";
Display1.uart.uart.txPin.$assign        = "ball.55";
Display1.uart.uart.rxPin.$assign        = "ball.57";
Display1.uart.uart.txDmaChannel.$assign = "UDMA_CH9";
Display1.uart.uart.rxDmaChannel.$assign = "UDMA_CH8";

ADC1.$name = "CONFIG_ADC_0";

ADC2.$name = "CONFIG_ADC_1";

Crypto1.$name = "CONFIG_Crypto_0";

GPIO1.$hardware       = system.deviceData.board.components.SW2;
GPIO1.$name           = "CONFIG_GPIO_BUTTON_0";
GPIO1.gpioPin.$assign = "boosterpack.3";

GPIO2.$hardware       = system.deviceData.board.components.SW3;
GPIO2.$name           = "CONFIG_GPIO_BUTTON_1";
GPIO2.gpioPin.$assign = "boosterpack.11";

GPIO3.$hardware      = system.deviceData.board.components.LED_RED;
GPIO3.outputStrength = "High";
GPIO3.$name          = "CONFIG_GPIO_LED_0";

GPIO4.$hardware      = system.deviceData.board.components.LED_GREEN;
GPIO4.outputStrength = "High";
GPIO4.$name          = "CONFIG_GPIO_LED_2";

GPIO5.$name           = "CONFIG_GPIO_0";
GPIO5.mode            = "Output";
GPIO5.gpioPin.$assign = "boosterpack.19";

GPIO6.$name           = "CONFIG_GPIO_1";
GPIO6.mode            = "Output";
GPIO6.gpioPin.$assign = "boosterpack.28";

GPIO7.$name           = "CONFIG_GPIO_2";
GPIO7.mode            = "Output";
GPIO7.gpioPin.$assign = "boosterpack.4";

GPIO8.$name = "CONFIG_GPIO_3";
GPIO8.mode  = "Output";

GPIO9.$name = "CONFIG_GPIO_4";
GPIO9.mode  = "Output";

GPIO10.$name = "CONFIG_GPIO_5";
GPIO10.mode  = "Output";

GPIO11.$name = "CONFIG_GPIO_6";
GPIO11.mode  = "Output";

GPIO12.$name = "CONFIG_GPIO_7";
GPIO12.mode  = "Output";

PWM1.$name                = "CONFIG_PWM_0";
PWM1.$hardware            = system.deviceData.board.components.LED_YELLOW;
PWM1.timer.pwmPin.$assign = "boosterpack.9";

Power.ioRetentionShutdown = ["GRP_1"];
Power.parkPins.$name      = "ti_drivers_power_PowerCC32XXPins0";

Timer1.$name         = "CONFIG_TIMER_0";
Timer1.timerType     = "32 Bits";
Timer1.timer.$assign = "Timer0";

Timer2.$name         = "CONFIG_TIMER_1";
Timer2.timer.$assign = "Timer1";

Timer3.$name         = "CONFIG_TIMER_2";
Timer3.timer.$assign = "Timer1";

UART1.$name          = "CONFIG_UART_1";
UART1.ringBufferSize = 64;

Watchdog1.$name            = "CONFIG_WATCHDOG_0";
Watchdog1.watchdog.$assign = "WATCHDOG0";

LED1.$name = "CONFIG_LED_0";

SlNet1.$name  = "CONFIG_SLNET";
SlNet1.ifName = "CC32xx";

/**
 * Pinmux solution for unlocked pins/peripherals. This ensures that minor changes to the automatic solver in a future
 * version of the tool will not impact the pinmux you originally saw.  These lines can be completely deleted in order to
 * re-solve from scratch.
 */
ADC1.adc.$suggestSolution             = "ADC0";
ADC1.adc.adcPin.$suggestSolution      = "boosterpack.26";
ADC2.adc.$suggestSolution             = "ADC0";
ADC2.adc.adcPin.$suggestSolution      = "boosterpack.2";
GPIO3.gpioPin.$suggestSolution        = "boosterpack.29";
GPIO4.gpioPin.$suggestSolution        = "boosterpack.10";
GPIO8.gpioPin.$suggestSolution        = "boosterpack.7";
GPIO9.gpioPin.$suggestSolution        = "boosterpack.14";
GPIO10.gpioPin.$suggestSolution       = "boosterpack.13";
GPIO11.gpioPin.$suggestSolution       = "boosterpack.17";
GPIO12.gpioPin.$suggestSolution       = "boosterpack.30";
PWM1.timer.$suggestSolution           = "Timer3";
UART1.uart.$suggestSolution           = "UART1";
UART1.uart.txPin.$suggestSolution     = "boosterpack.15";
UART1.uart.rxPin.$suggestSolution     = "boosterpack.18";
LED1.gpioPin.gpioPin.$suggestSolution = "boosterpack.24";
